## west.yml
```yaml
# SPDX-License-Identifier: Apache-2.0
# West YAML manifest for Zephyr as Xen Dom0

manifest:
  self:
    path: zephyr-blinky

  remotes:
    - name: zephyrproject-rtos
      url-base: https://github.com/automotive-grade-linux/

  projects:
    - name: zephyr
      remote: zephyrproject-rtos
      revision: sparrowhawk-gpio-demo
      west-commands: scripts/west-commands.yml
```
